## boards/arm/enya_gt_wheel/Kconfig.board
```kconfig
# Electronya DIY GT Wheel board configuration

# Copyright (c) 2023 Electronya

config BOARD_ENYA_GT_WHEEL
	bool "Electronya DIY GT Wheel."
	depends on SOC_STM32F303XE
```

## boards/arm/enya_gt_wheel/Kconfig.defconfig
```kconfig
# NUCLEO-64 F302R8 board configuration

# Copyright (c) 2020 Paul M. Bendixen
# SPDX-License-Identifier: Apache-2.0

if BOARD_ENYA_GT_WHEEL

config BOARD
	default "enya_gt_wheel"

config SPI_STM32_INTERRUPT
	default y
	depends on SPI

endif # BOARD_ENYA_GT_WHEEL
```

## boards/arm/enya_gt_wheel/enya_gt_wheel_defconfig
```kconfig
# Copyright (C) 2023 by Electronya

CONFIG_SOC_SERIES_STM32F3X=y
CONFIG_SOC_STM32F303XE=y
CONFIG_HEAP_MEM_POOL_SIZE=256

# Enable MPU
CONFIG_ARM_MPU=y

# Enable HW stack protection
CONFIG_HW_STACK_PROTECTION=y

# console
CONFIG_SERIAL=y
CONFIG_CONSOLE=y
CONFIG_UART_CONSOLE=y

# enable ADC
CONFIG_ADC=y
CONFIG_ADC_STM32=y

# enable GPIO
CONFIG_GPIO=y

# SPI
CONFIG_SPI=y
CONFIG_SPI_STM32_DMA=y

# LED Strip
CONFIG_LED_STRIP=y
CONFIG_WS2812_STRIP=y

# Enable Clocks
CONFIG_CLOCK_CONTROL=y

# enable pin controller
CONFIG_PINCTRL=y

# USB
CONFIG_USB_COMPOSITE_DEVICE=y
CONFIG_USB_DEVICE_STACK=y
CONFIG_USB_DEVICE_PRODUCT="Electronya GT Sim Racing Wheel"
# CONFIG_USB_DEVICE_VID=TBD
CONFIG_USB_DEVICE_PID=0x0003
CONFIG_USB_DEVICE_INITIALIZE_AT_BOOT=n
CONFIG_USB_DEVICE_HID=y

# Electronya wrapper
CONFIG_ENYA_ZEPHYR_WRAPPER=y
CONFIG_ENYA_ADC=y
CONFIG_ENYA_GPIO=y
CONFIG_ENYA_LED_STRIP=y
CONFIG_ENYA_USB=y
CONFIG_ENYA_USB_ACM=y
```

## tests/unit/testcase.yaml
```yaml
tests:
  gt_wheel.ledCtrl:
    platform_allow: qemu_cortex_m0
    tags: ledCtrl
    extra_args: TEST_SUITE=ledCtrl
    extra_configs:
      - CONFIG_ZTEST=y
      - CONFIG_ZTEST_NEW_API=y
      - CONFIG_LED_STRIP=y
      - CONFIG_ENYA_ZEPHYR_WRAPPER=y
      - CONFIG_ENYA_LED_STRIP=y
      - CONFIG_HEAP_MEM_POOL_SIZE=256
  gt_wheel.buttonMngr:
    platform_allow: qemu_cortex_m3
    tags: buttonMngr
    extra_args: TEST_SUITE=buttonMngr
    extra_configs:
      - CONFIG_ZTEST=y
      - CONFIG_ZTEST_NEW_API=y
      - CONFIG_GPIO=y
      - CONFIG_ENYA_ZEPHYR_WRAPPER=y
      - CONFIG_ENYA_GPIO=y
      - CONFIG_HEAP_MEM_POOL_SIZE=640
  gt_wheel.clutchReader:
    platform_allow: qemu_cortex_m0
    tags: clutchReader
    extra_args: TEST_SUITE=clutchReader
    extra_configs:
      - CONFIG_ZTEST=y
      - CONFIG_ZTEST_NEW_API=y
      - CONFIG_ADC=y
      - CONFIG_ADC_SHELL=n
      - CONFIG_ENYA_ZEPHYR_WRAPPER=y
      - CONFIG_ENYA_ADC=y
      - CONFIG_HEAP_MEM_POOL_SIZE=256
  gt_wheel.acmDevice:
    platform_allow: qemu_cortex_m3
    tags: acmDevice
    extra_args: TEST_SUITE=acmDevice
    extra_configs:
      - CONFIG_ZTEST=y
      - CONFIG_ZTEST_NEW_API=y
      - CONFIG_ENYA_ZEPHYR_WRAPPER=y
      - CONFIG_ENYA_USB=y
      - CONFIG_ENYA_USB_ACM=y
      - CONFIG_HEAP_MEM_POOL_SIZE=256
  gt_wheel.simhubPkt:
    platform_allow: qemu_cortex_m3
    tags: simhubPkt
    extra_args: TEST_SUITE=simhubPkt
    extra_configs:
      - CONFIG_ZTEST=y
      - CONFIG_ZTEST_NEW_API=y
      - CONFIG_LED_STRIP=y
      - CONFIG_ENYA_ZEPHYR_WRAPPER=y
      - CONFIG_ENYA_LED_STRIP=y
      - CONFIG_HEAP_MEM_POOL_SIZE=256
```
